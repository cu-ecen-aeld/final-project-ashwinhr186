## base_external/Config.in
```kconfig
source "$BR2_EXTERNAL_project_base_PATH/package/lcd/Config.in"
source "$BR2_EXTERNAL_project_base_PATH/package/numpad/Config.in"
source "$BR2_EXTERNAL_project_base_PATH/package/fingerprint/Config.in"
source "$BR2_EXTERNAL_project_base_PATH/package/python-rpigpio/Config.in"
source "$BR2_EXTERNAL_project_base_PATH/package/python-pyfingerprint/Config.in"
source "$BR2_EXTERNAL_project_base_PATH/package/python-adafruit-fingerprint/Config.in"
source "$BR2_EXTERNAL_project_base_PATH/package/python-adafruit-circuitpython-fingerprint/Config.in"
source "$BR2_EXTERNAL_project_base_PATH/package/python-invoke/Config.in"
source "$BR2_EXTERNAL_project_base_PATH/package/python-pathlib/Config.in"
source "$BR2_EXTERNAL_project_base_PATH/package/python-ctypes/Config.in"
source "$BR2_EXTERNAL_project_base_PATH/package/auth_system/Config.in"
```

## base_external/package/aesd-chardriver/Config.in
```kconfig
config BR2_PACKAGE_AESD_CHARDRIVER
	bool "aesd-chardriver"
	help
	  This package includes aesd-chardriver module implementation.
	  Helps to understand buildroot external trees and package builds.
```

## base_external/package/auth_system/Config.in
```kconfig
config BR2_PACKAGE_AUTH_SYSTEM
	bool "auth_system"
	help
	  This package includes auth system python source code which makes use numpad and fingerprint application.
	  Helps to understand buildroot external trees and package builds.
```

## base_external/package/client/Config.in
```kconfig
config BR2_PACKAGE_CLIENT
	bool "client"
	help
	  This package includes client python source code.
	  Helps to understand buildroot external trees and package builds.
```

## base_external/package/fingerprint/Config.in
```kconfig
config BR2_PACKAGE_FINGERPRINT
	bool "fingerprint"
	help
	  This package includes fingerprint sample python source code.
	  Helps to understand buildroot external trees and package builds.
```

## base_external/package/lcd/Config.in
```kconfig
config BR2_PACKAGE_LCD
	bool "lcd"
	help
	  This package includes lcd display related modules implementation.
	  Helps to understand buildroot external trees and package builds.
```

## base_external/package/ldd/Config.in
```kconfig
config BR2_PACKAGE_LDD
	bool "ldd"
	help
	  This package includes the Misc-modules and Scull components in the rootfs of the image.
	  Helps to understand buildroot external trees and package builds.
```

## base_external/package/numpad/Config.in
```kconfig
config BR2_PACKAGE_NUMPAD
	bool "numpad"
	help
	  This package includes numpad python source code.
	  Helps to understand buildroot external trees and package builds.
```

## base_external/package/python-adafruit-circuitpython-fingerprint/Config.in
```kconfig
config BR2_PACKAGE_PYTHON_ADAFRUIT_CIRCUITPYTHON_FINGERPRINT
	bool "python-adafruit-circuitpython-fingerprint"
	help
	  This package includes adafruit circuitpython fingerprint python source code.
	  Helps to understand buildroot external trees and package builds.
```

## base_external/package/python-adafruit-fingerprint/Config.in
```kconfig
config BR2_PACKAGE_PYTHON_ADAFRUIT_FINGERPRINT
	bool "python-adafruit-fingerprint"
	help
	  This package includes adafruit-fingerprint sample python source code.
	  Helps to understand buildroot external trees and package builds.
```

## base_external/package/python-ctypes/Config.in
```kconfig
config BR2_PACKAGE_PYTHON_CTYPES
	bool "python-ctypes"
	help
	  This package includes python ctypes source code.
	  Helps to understand buildroot external trees and package builds.
```

## base_external/package/python-invoke/Config.in
```kconfig
config BR2_PACKAGE_PYTHON_INVOKE
	bool "python-invoke"
	help
	  This package includes python invoke  source code.
	  Helps to understand buildroot external trees and package builds.
```

## base_external/package/python-pathlib/Config.in
```kconfig
config BR2_PACKAGE_PYTHON_PATHLIB
	bool "python-pathlib"
	help
	  This package includes python pathlib source code.
	  Helps to understand buildroot external trees and package builds.
```

## base_external/package/python-pyfingerprint/Config.in
```kconfig
config BR2_PACKAGE_PYTHON_PYFINGERPRINT
	bool "python-pyfingerprint"
	help
	  This package includes pyfingerprint python package.
	  Helps to understand buildroot external trees and package builds.
```

## base_external/package/python-rpigpio/Config.in
```kconfig
config BR2_PACKAGE_PYTHON_RPIGPIO
	bool "python-rpigpio"
	help
	  This package includes RPIGPIO python package.
	  Helps to understand buildroot external trees and package builds.
```
